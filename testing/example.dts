/dts-v1/;
/plugin/;

/* A block comment
 * spanning multiple lines
 */
#include "base.dtsi"

/ {
	aliases {
		led0 = &led_0;
	};

	soc {
		#address-cells = <1>;
		#size-cells = <1>;

		uart0: serial@40002000 {
			compatible = "acme,uart";
			reg = <0x40002000 0x1000>;
			interrupts = <2 1>;
			status = "disabled";
		};
	};
};

&uart0 {
	status = "okay";
	current-speed = <115200>;
};

/memreserve/ 0x10000000 0x4000;
/delete-property/ dma-names;
/omit-if-no-ref/ &uart0;
